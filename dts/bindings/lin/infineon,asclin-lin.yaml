## dts/bindings/lin/infineon,asclin-lin.yaml
```yaml
# Copyright (c) 2026 Linumiz
# SPDX-License-Identifier: Apache-2.0

description: Infineon AURIX ASCLIN LIN controller

compatible: "infineon,asclin-lin"

include: [lin-controller.yaml, pinctrl-device.yaml]

properties:
  reg:
    required: true

  interrupts:
    required: true
    description: |
      TX (header/response), RX (header/response + FIFO),
      error (parity, framing, collision, timeout, break, autobaud, overflow).

  interrupt-names:
    required: true

  clocks:
    required: true

  clock-names:
    required: true
    description: Module clock. "fasclinf" preferred over "fasclins" if both present.

  pinctrl-0:
    required: true

  pinctrl-names:
    required: true

  phys:
    type: phandle
    description: Optional transceiver phandle (e.g., lin-transceiver-gpio).

  oversampling:
    type: int
    default: 16
    description: Bit oversampling (4-16); higher improves noise immunity.

  samplepoint:
    type: int
    default: 8
    description: Sample point position (1..oversampling-1).

  median-filter:
    type: boolean
    description: Enable 3-sample median filter.

  prescaler:
    type: int
    default: 1
    description: Module clock prescaler (1..4096).

  brg-numerator:
    type: int
    description: Force BRG.NUMERATOR; paired with brg-denominator.

  brg-denominator:
    type: int
    description: Force BRG.DENOMINATOR; zero triggers Stern-Brocot approximation.

  bus-idle-timeout-ms:
    type: int
    default: 4000
    description: |
      Idle ms before sleep-eligible and wake-up detection.
      Re-armed on transaction completion/header RX. 0 disables
      wake-up. LIN spec default is 4000 ms.
```

## dts/bindings/mbox/infineon,aurix-gpsr.yaml
```yaml
#
# Copyright (c) 2024, Infineon Technologies AG
#
# SPDX-License-Identifier: Apache-2.0
#

description: Mbox implementation for the Aurix SoCs based on GPSR IRQs

compatible: infineon,aurix-gpsr

include: [base.yaml, mailbox-controller.yaml]

properties:
  reg:
    required: true

  interrupts:
    required: true

  rx-channels:
    type: array

mbox-cells:
  - channel
```

## dts/bindings/spi/infineon,aurix-qspi.yaml
```yaml
# Copyright (c) 2026 Linumiz
# SPDX-License-Identifier: Apache-2.0

description: Infineon Aurix QSPI controller (Queued SPI)

compatible: "infineon,aurix-qspi"

include: [spi-controller.yaml, pinctrl-device.yaml]

properties:
  reg:
    required: true

  clocks:
    required: true

  interrupts:
    required: true

  interrupt-names:
    required: true

  infineon,loopback:
    type: boolean
    description: |
      Enable QSPI internal loopback (GLOBALCON.LB=1) and disable all SLSO
      outputs (SSOC.OEN=0). Used to validate the controller without driving
      any on-board slave. For bring-up and self-test only.

  infineon,sclk-frequency:
    type: int
    default: 1000000
    description: |
      Target SCLK frequency in Hz produced by ECON[0]/GLOBALCON.TQ when no
      runtime spi_config.frequency is supplied. Defaults to 1 MHz.
```

## dts/bindings/watchdog/infineon,aurix-watchdog.yaml
```yaml
# Copyright (c) 2024, Infineon Technologies AG
# SPDX-License-Identifier: Apache-2.0

description: Infineon Aurix Watchdog

compatible: "infineon,aurix-watchdog"

include: base.yaml

properties:
  reg:
    required: true
```

## samples/boards/infineon/tricore_bitfield_pack/sample.yaml
```yaml
sample:
  name: TriCore Bitfield Packing
tests:
  sample.boards.infineon.tricore_bitfield_pack:
    platform_allow: kit_a3g_tc4d7_lite/tc4d7xp/tc
    tags: tricore
```

## samples/drivers/can/counter/boards/kit_a2g_tc397xa_3v3_tft_tc397xp_cpu0.conf
```kconfig
CONFIG_LOOPBACK_MODE=n
CONFIG_SHELL=n
CONFIG_CAN_SHELL=n
CONFIG_DEVICE_SHELL=n
CONFIG_STATS_SHELL=n
CONFIG_CAN_STATS=n

# Surface init errors during bring-up
CONFIG_LOG=y
CONFIG_LOG_MODE_IMMEDIATE=y
CONFIG_CAN_LOG_LEVEL_DBG=y
```

## samples/drivers/can/counter/boards/kit_a3g_tc4d7_lite_tc4d7xp_cpu0.conf
```kconfig
CONFIG_LOOPBACK_MODE=y
CONFIG_SHELL=n
CONFIG_CAN_SHELL=n
CONFIG_DEVICE_SHELL=n
CONFIG_STATS_SHELL=n
CONFIG_CAN_STATS=n
```

## soc/infineon/aurix/tc3x/Kconfig.soc
```kconfig
# Copyright (c) 2024 Infineon Technologies AG
# SPDX-License-Identifier: Apache-2.0

# Infineon Aurix 2nd Generation Devices

config SOC_SERIES_TC3X
	select SOC_FAMILY_AURIX
	help
	  Enable support for TC3X MCU series

config SOC_SERIES
    default "tc3x" if SOC_SERIES_TC3X

config SOC_TC33x
	bool
	select SOC_SERIES_TC3X

config SOC_TC33xED
	bool
	select SOC_SERIES_TC3X

config SOC_TC35x
	bool
	select SOC_SERIES_TC3X

config SOC_TC36x
	bool
	select SOC_SERIES_TC3X

config SOC_TC37x
	bool
	select SOC_SERIES_TC3X

config SOC_TC37xED
	bool
	select SOC_SERIES_TC3X

config SOC_TC38x
	bool
	select SOC_SERIES_TC3X

config SOC_TC39xB
	bool
	select SOC_SERIES_TC3X

config SOC_TC375TP
	bool
	select SOC_TC37x

config SOC_TC377TX
	bool
	select SOC_TC37xED

config SOC_TC387QP
	bool
	select SOC_TC38x
	
config SOC_TC397XA 
	bool
	select SOC_TC39xB

config SOC
	default "tc375tp" if SOC_TC375TP
	default "tc377tx" if SOC_TC377TX
	default "tc387qp" if SOC_TC387QP
	default "tc397xa" if SOC_TC397XA
```

## soc/infineon/aurix/tc4x/Kconfig.amp
```kconfig
# Copyright (c) 2024 Infineon Technologies AG
# SPDX-License-Identifier: Apache-2.0

config TRICORE_AMP
	bool "TriCore AMP support"
	depends on SOC_SERIES_TC4X
	help
	  CPU0 starts secondary CPUs after clock init.

config TRICORE_AMP_CPU_MASK
	hex "Secondary CPU bitmask"
	default 0x02
	depends on TRICORE_AMP
	help
	  Bit 1 = CPU1, Bit 2 = CPU2, etc.
```

## soc/infineon/aurix/tc4x/Kconfig.defconfig
```kconfig
# Copyright 2024 Infineon Technologies AG
# SPDX-License-Identifier: Apache-2.0

if SOC_SERIES_TC4X

config NUM_IRQS
    default 2048

config AURIX_NEXT_CORE_ID
	int "Index of the next core to start (0 = none)"
	range 0 5
	default 0

config AURIX_NEXT_CORE_START_ADDRESS
	default 0x80400000 if (AURIX_NEXT_CORE_ID=1)
	default 0x80800000 if (AURIX_NEXT_CORE_ID=2)
	default 0x80A00000 if (AURIX_NEXT_CORE_ID=3)
	default 0x80E00000 if (AURIX_NEXT_CORE_ID=4)
	default 0x81200000 if (AURIX_NEXT_CORE_ID=5)
	default 0

config ETH_QOS_SHARED_DMA
	default y

config ETH_XGMAC_SHARED_DMA
	default y

config TRICORE_MPU_CODE_REGIONS
	default 16

config TRICORE_MPU_DATA_REGIONS
	default 24

config TRICORE_MPU_PROTECTION_SETS
	default 8
endif
```

## soc/qemu/tc4x/Kconfig.defconfig
```kconfig
# SPDX-License-Identifier: Apache-2.0

if TEST
config TRICORE_CSA_COUNT
	default 384
endif
```
