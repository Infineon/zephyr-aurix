/*
 * Copyright (c) 2026 Infineon Technologies AG
 *
 * SPDX-License-Identifier: Apache-2.0
 */

#include <mem.h>
#include <infineon/tc3x/tc36x.dtsi>
#include <infineon/tc3x/tc3x6-pinctrl.dtsi>

/ {

};