## arch/tricore/Kconfig
```kconfig
# Copyright (c) 2024 Infineon Technologies AG
# SPDX-License-Identifier: Apache-2.0

menu "TriCore Architecture Options"
	depends on TRICORE

config ARCH
	string
	default "tricore"

config CPU_TC162
	select ARCH_HAS_NOCACHE_MEMORY_SUPPORT
	select CPU_HAS_DCACHE
	select CPU_HAS_ICACHE
	select CPU_CACHE_INCOHERENT
	select CPU_HAS_FPU
	imply FPU
	bool

config CPU_TC18
	select ARCH_HAS_NOCACHE_MEMORY_SUPPORT
	select CPU_HAS_DCACHE
	select CPU_HAS_ICACHE
	select CPU_CACHE_INCOHERENT
	bool

config TRICORE_CSA_COUNT
	int "Number of Context Save Areas allocated"
	default 256
	help
		This option controls the number of Context Save Areas (CSAs) allocated by the
		kernel. CSAs are used to store the upper and lower context information during
		function calls and interrupts. The default value of 256 is typically sufficient
		for most applications, but it can be increased if your application has a large
		number of nested function calls, interrupts or threads.

config TRICORE_RESET_TRAMPOLINE
	bool "Trampoline to jump to cached address"
	default y
	help
		Enable startup trampoline function which jumps from
		any address (e.g. no cached) to the actual startup
		function.

config TRICORE_STACK_PROTECTION
	bool
	default y if HW_STACK_PROTECTION
	select MPU_STACK_GUARD if TRICORE_MPU
	help
		Enable hardware stack protection. When enabled, the kernel will use the
		MPU to create a guard area at the bottom of each thread's stack. Accessing this
		guard area will trigger a fault, allowing stack overflows to be detected.

menu "TriCore Processor Options"

config CPU_HAS_CUSTOM_FIXED_SOC_MPU_REGIONS
	bool "Custom fixed SoC MPU region definition"
	help
	  If enabled, the SoC defines and configures its own fixed MPU regions in
	  the SoC layer. These fixed MPU regions are programmed at boot time and
	  typically set the default access policies for flash and SRAM.

config TRICORE_MPU
	bool "TriCore MPU Support"
	select THREAD_STACK_INFO
	select CPU_HAS_MPU
	select MPU
	select MPU_REQUIRES_POWER_OF_TWO_ALIGNMENT
	select ARCH_HAS_USERSPACE
	select ARCH_HAS_STACK_PROTECTION
	select ARCH_MEM_DOMAIN_SUPPORTS_ISOLATED_STACKS
	select ARCH_MEM_DOMAIN_DATA if USERSPACE
	select ARCH_MEM_DOMAIN_SYNCHRONOUS_API if USERSPACE
	select MEM_DOMAIN_HAS_THREAD_LIST if USERSPACE
	select SRAM_REGION_PERMISSIONS
	help
	  Enable the TriCore Memory Protection Unit. The MPU enforces per-region
	  read, write and execute access permissions and provides stack guard and
	  user-thread isolation when combined with USERSPACE.

if TRICORE_MPU

config TRICORE_MPU_CODE_REGIONS
	int "Number of MPU code regions"
	default 8
	help
	  Number of code-protection regions (CPRs) supported by the MPU on this
	  SoC. Used to bound region allocation tables at compile time.

config TRICORE_MPU_DATA_REGIONS
	int "Number of MPU data regions"
	default 16
	help
	  Number of data-protection regions (DPRs) supported by the MPU on this
	  SoC.

config TRICORE_MPU_PROTECTION_SETS
	int "Number of MPU protection sets"
	default 4
	help
	  Number of protection sets (PRS) supported by the MPU on this SoC. PRS 0
	  is used by kernel and ISR contexts.

endif # TRICORE_MPU

config MPU_STACK_GUARD
	bool
	depends on HW_STACK_PROTECTION

config MPU_STACK_GUARD_MIN_SIZE
	int "Stack Guard area size"
	depends on MPU_STACK_GUARD
	default 128
	help
	  Hardware stack protection installs a guard area at the bottom of the
	  stack using the MPU. Accessing the guard area triggers a fault so stack
	  overflows can be caught.

if CPU_TC18
config CPU_HAS_TRICORE_VIRTUALIZATION
	bool
	default n

config TRICORE_VIRTUALIZATION
	bool "TriCore Virtualization Support"
	depends on CPU_HAS_TRICORE_VIRTUALIZATION
	default n
	help
		When enabled, the kernel will use the virtualization features of the TriCore
		architecture to support running multiple virtual machines (VMs) on the same
		hardware. Each VM can run its own instance of the operating system or
		applications, providing isolation and security between them. This option is
		only available on CPUs that support TriCore virtualization.

config TRICORE_VM_ID
	int "TriCore Virtual Machine ID"
	depends on TRICORE_VIRTUALIZATION
	default 0
	help
		This option specifies the ID of the virtual machine (VM) that the kernel will
		run on when TriCore virtualization is enabled.
		 * VM0 is the hypervisor VM, which is responsible for managing the other VMs
		and providing access to shared resources. It has dedicated hardware resources
		(HRHV) and is responsible for handling hvcall instructions and IRQ requests
		for VM2 - VM7.
		 * VM1 is the real-time VM, which is designed for running real-time applications
		that require low-latency and deterministic behavior. It has dedicated hardware
		resources (HRA). IRQs mapped to VM1 are handled directly by the CPU and
		do not trigger the hypervisor.
		 * VM2 - VM7 are general-purpose VMs that can be used for running various
		applications. They share a common hardware resource (HRB) and rely on the
		hypervisor to schedule their execution. IRQs mapped to a VM that is not loaded
		in HRB trigger the hypervisor.
endif

endmenu

config DCACHE_LINE_SIZE
	default 32

config ICACHE_LINE_SIZE
	default 32

config GEN_ISR_TABLES
	default y

config GEN_IRQ_VECTOR_TABLE
	default n

config NUM_IRQ_PRIORITIES
	int
	default 256

config MAIN_STACK_SIZE
	default 4096 if TRICORE_MPU

config IDLE_STACK_SIZE
	default 2048 if TRICORE_MPU

config ISR_STACK_SIZE
	default 4096 if MPU_STACK_GUARD

config TEST_EXTRA_STACK_SIZE
	default 1024 if TRICORE_MPU

endmenu
```

## boards/infineon/kit_a2g_tc377tx_3v3_tr/Kconfig.kit_a2g_tc377tx_3v3_tr
```kconfig
# Copyright 2024 Infineon Technologies AG
# SPDX-License-Identifier: Apache-2.0

config BOARD_KIT_A2G_TC377TX_3V3_TR
	bool "Infineon TC377TX TriBoard"
	select SOC_TC377TX

config TRICORE_CORE_ID
	int
	default 0 if BOARD_KIT_A2G_TC377TX_3V3_TR_TC377TX_CPU0
	default 1 if BOARD_KIT_A2G_TC377TX_3V3_TR_TC377TX_CPU1
	default 2 if BOARD_KIT_A2G_TC377TX_3V3_TR_TC377TX_CPU2
```

## boards/infineon/kit_a2g_tc377tx_3v3_tr/board.yml
```yaml
# Copyright 2024 Infineon Technologies AG
# SPDX-License-Identifier: Apache-2.0

board:
  name: kit_a2g_tc377tx_3v3_tr
  full_name: TriBoard TC377TX 
  vendor: infineon
  socs:
    - name: tc377tx
```

## boards/infineon/kit_a2g_tc397xa_3v3_tft/Kconfig.kit_a2g_tc397xa_3v3_tft
```kconfig
# Copyright 2024 Infineon Technologies AG
# SPDX-License-Identifier: Apache-2.0

config BOARD_KIT_A2G_TC397XA_3V3_TFT
	bool "Infineon TC397 ADAS Application Kit"
	select SOC_TC397XA

config TRICORE_CORE_ID
	int
	default 0 if BOARD_KIT_A2G_TC397XA_3V3_TFT_TC397XA_CPU0
	default 1 if BOARD_KIT_A2G_TC397XA_3V3_TFT_TC397XA_CPU1
	default 2 if BOARD_KIT_A2G_TC397XA_3V3_TFT_TC397XA_CPU2
	default 3 if BOARD_KIT_A2G_TC397XA_3V3_TFT_TC397XA_CPU3
	default 4 if BOARD_KIT_A2G_TC397XA_3V3_TFT_TC397XA_CPU4
	default 5 if BOARD_KIT_A2G_TC397XA_3V3_TFT_TC397XA_CPU5
```

## boards/infineon/kit_a2g_tc3x6_trb/Kconfig.kit_a2g_tc3x6_trb
```kconfig
# Copyright 2026 Infineon Technologies AG
# SPDX-License-Identifier: Apache-2.0

config BOARD_KIT_A2G_TC3X6_TRB
	bool "Infineon TC3x6 TriBoard"
	select SOC_TC366DP

config TRICORE_CORE_ID
	int
	default 0 if BOARD_KIT_A2G_TC3X6_TRB_TC366DP_CPU0
	default 1 if BOARD_KIT_A2G_TC3X6_TRB_TC366DP_CPU1
```

## boards/infineon/kit_a2g_tc3x6_trb/board.yml
```yaml
# Copyright 2026 Infineon Technologies AG
# SPDX-License-Identifier: Apache-2.0

board:
  name: kit_a2g_tc3x6_trb
  full_name: TriBoard TC3X6
  vendor: infineon
  revision:
    format: major.minor.patch
    default: "1.0.0"
    revisions:
      - name: "1.0.0"
  socs:
    - name: tc366dp
```

## boards/infineon/kit_a2g_tc3x7_tft/Kconfig.defconfig
```kconfig
# Copyright 2024 Infineon Technologies AG
# SPDX-License-Identifier: Apache-2.0

if NETWORKING

config NET_L2_ETHERNET
	default y
config MDIO
	default y
config TEST_RANDOM_GENERATOR
	default y

endif # NETWORKING
```

## boards/infineon/kit_a2g_tc3x7_tft/Kconfig.kit_a2g_tc3x7_tft
```kconfig
# Copyright 2024 Infineon Technologies AG
# SPDX-License-Identifier: Apache-2.0

config BOARD_KIT_A2G_TC3X7_TFT
	bool "Infineon TC387 Application Kit"
	select SOC_TC387QP

config TRICORE_CORE_ID
	int
	default 0 if BOARD_KIT_A2G_TC3X7_TFT_TC387QP_CPU0
	default 1 if BOARD_KIT_A2G_TC3X7_TFT_TC387QP_CPU1
	default 2 if BOARD_KIT_A2G_TC3X7_TFT_TC387QP_CPU2
	default 3 if BOARD_KIT_A2G_TC3X7_TFT_TC387QP_CPU3
```

## boards/infineon/kit_a2g_tc3x7_tft/board.yml
```yaml
# Copyright 2024 Infineon Technologies AG
# SPDX-License-Identifier: Apache-2.0

board:
  name: kit_a2g_tc3x7_tft
  full_name: Application Kit TC3X7
  vendor: infineon
  socs:
    - name: tc387qp
```

## boards/infineon/kit_a2g_tc3x7_tft/kit_a2g_tc3x7_tft_tc387qp_cpu0_defconfig
```kconfig
# Copyright 2024 Infineon Technologies AG
# SPDX-License-Identifier: Apache-2.0

CONFIG_SERIAL=y
CONFIG_GPIO=y
CONFIG_LED=y
CONFIG_ADC=y
CONFIG_INPUT=y

CONFIG_CONSOLE=y
CONFIG_UART_CONSOLE=y
```

## boards/infineon/kit_a2g_tc3x7_trb/Kconfig.kit_a2g_tc3x7_trb
```kconfig
# Copyright 2024 Infineon Technologies AG
# SPDX-License-Identifier: Apache-2.0

config BOARD_KIT_A2G_TC3X7_TRB
	bool "Infineon TC3x7 TriBoard"
	select SOC_TC397XA

config TRICORE_CORE_ID
	int
	default 0 if BOARD_KIT_A2G_TC3X7_TRB_TC397XA_CPU0
	default 1 if BOARD_KIT_A2G_TC3X7_TRB_TC397XA_CPU1
	default 2 if BOARD_KIT_A2G_TC3X7_TRB_TC397XA_CPU2
	default 3 if BOARD_KIT_A2G_TC3X7_TRB_TC397XA_CPU3
	default 4 if BOARD_KIT_A2G_TC3X7_TRB_TC397XA_CPU4
	default 5 if BOARD_KIT_A2G_TC3X7_TRB_TC397XA_CPU5
```

## boards/infineon/kit_a2g_tc3x7_trb/board.yml
```yaml
# Copyright 2024 Infineon Technologies AG
# SPDX-License-Identifier: Apache-2.0

board:
  name: kit_a2g_tc3x7_trb
  full_name: TriBoard TC3X7
  vendor: infineon
  revision:
    format: major.minor.patch
    default: "2.0.0"
    revisions:
      - name: "1.0.0"
      - name: "2.0.0"
  socs:
    - name: tc397xp
```

## boards/infineon/kit_a3g_tc4d7_lite/Kconfig.defconfig
```kconfig
if NETWORKING

config NET_L2_ETHERNET
	default y
config MDIO
	default y
config TEST_RANDOM_GENERATOR
	default y

endif # NETWORKING
```

## boards/infineon/kit_a3g_tc4d7_lite/Kconfig.kit_a3g_tc4d7_lite
```kconfig
# Copyright 2025 Infineon Technologies AG
# SPDX-License-Identifier: Apache-2.0

config BOARD_KIT_A3G_TC4D7_LITE_TC4D7XP
	bool
	default y if BOARD_KIT_A3G_TC4D7_LITE_TC4D7XP_CPU0
	default y if BOARD_KIT_A3G_TC4D7_LITE_TC4D7XP_CPU1
	default y if BOARD_KIT_A3G_TC4D7_LITE_TC4D7XP_CPU2
	default y if BOARD_KIT_A3G_TC4D7_LITE_TC4D7XP_CPU3
	default y if BOARD_KIT_A3G_TC4D7_LITE_TC4D7XP_CPU4
	default y if BOARD_KIT_A3G_TC4D7_LITE_TC4D7XP_CPU5
	default y if BOARD_KIT_A3G_TC4D7_LITE_TC4D7XP_CPUCS

config BOARD_KIT_A3G_TC4D7_LITE
	bool "Infineon A3G TC4D7 Lite Kit"
	select SOC_TC4D7XP if BOARD_KIT_A3G_TC4D7_LITE_TC4D7XP

config TRICORE_CORE_ID
	int
	default 0 if BOARD_KIT_A3G_TC4D7_LITE_TC4D7XP_CPU0
	default 1 if BOARD_KIT_A3G_TC4D7_LITE_TC4D7XP_CPU1
	default 2 if BOARD_KIT_A3G_TC4D7_LITE_TC4D7XP_CPU2
	default 3 if BOARD_KIT_A3G_TC4D7_LITE_TC4D7XP_CPU3
	default 4 if BOARD_KIT_A3G_TC4D7_LITE_TC4D7XP_CPU4
	default 5 if BOARD_KIT_A3G_TC4D7_LITE_TC4D7XP_CPU5
	default 6 if BOARD_KIT_A3G_TC4D7_LITE_TC4D7XP_CPUCS
	default 0
```

## boards/infineon/kit_a3g_tc4d7_lite/board.yml
```yaml
board:
  name: kit_a3g_tc4d7_lite
  full_name: KIT A3G TC4D7 LITE
  vendor: infineon
  socs:
    - name: tc4d7xp
```

## boards/infineon/kit_a3g_tc4d7_lite/kit_a3g_tc4d7_lite_tc4d7xp_cpu0_defconfig
```kconfig
# Copyright 2024 Infineon Technologies AG
# SPDX-License-Identifier: Apache-2.0

CONFIG_SERIAL=y
CONFIG_GPIO=y
CONFIG_LED=y

CONFIG_CONSOLE=y
CONFIG_UART_CONSOLE=y

CONFIG_POSIX_AEP_CHOICE_NONE=y
CONFIG_TRICORE_AMP=y
```

## boards/infineon/kit_tc4x7_com_trb/Kconfig.kit_tc4x7_com_trb
```kconfig
# Copyright 2024 Infineon Technologies AG
# SPDX-License-Identifier: Apache-2.0

config BOARD_KIT_TC4X7_COM_TRB_TC4D7XP
	bool
	default y if BOARD_KIT_TC4X7_COM_TRB_TC4D7XP_CPU0
	default y if BOARD_KIT_TC4X7_COM_TRB_TC4D7XP_CPU1
	default y if BOARD_KIT_TC4X7_COM_TRB_TC4D7XP_CPU2
	default y if BOARD_KIT_TC4X7_COM_TRB_TC4D7XP_CPU3
	default y if BOARD_KIT_TC4X7_COM_TRB_TC4D7XP_CPU4
	default y if BOARD_KIT_TC4X7_COM_TRB_TC4D7XP_CPU5
	default y if BOARD_KIT_TC4X7_COM_TRB_TC4D7XP_CPUCS

config BOARD_KIT_TC4X7_COM_TRB
	bool "Infineon TC4X7 COM TriBoard"
	select SOC_TC4D7XP if BOARD_KIT_TC4X7_COM_TRB_TC4D7XP

config TRICORE_CORE_ID
	int
	default 0 if BOARD_KIT_TC4X7_COM_TRB_TC4D7XP_CPU0
	default 1 if BOARD_KIT_TC4X7_COM_TRB_TC4D7XP_CPU1
	default 2 if BOARD_KIT_TC4X7_COM_TRB_TC4D7XP_CPU2
	default 3 if BOARD_KIT_TC4X7_COM_TRB_TC4D7XP_CPU3
	default 4 if BOARD_KIT_TC4X7_COM_TRB_TC4D7XP_CPU4
	default 5 if BOARD_KIT_TC4X7_COM_TRB_TC4D7XP_CPU5
	default 6 if BOARD_KIT_TC4X7_COM_TRB_TC4D7XP_CPUCS
```

## boards/infineon/kit_tc4x7_com_trb/board.yml
```yaml
# Copyright 2024 Infineon Technologies AG
# SPDX-License-Identifier: Apache-2.0

board:
  name: kit_tc4x7_com_trb
  full_name: TriBoard TC4x7 COM 
  vendor: infineon
  socs:
    - name: tc4d7xp
```

## drivers/can/Kconfig.mcmcan
```kconfig
# Copyright (c) 2024 Infineon Technologies AG
# SPDX-License-Identifier: Apache-2.0

config CAN_MCMCAN
	bool "Infineon AURIX MCMCAN driver"
	default y
	depends on DT_HAS_INFINEON_MCMCAN_ENABLED
	depends on CLOCK_CONTROL
	select CAN_MCAN
	select PINCTRL
	help
	  Enable support for the Infineon AURIX MCMCAN module (TC3x/TC4x).
	  The driver wraps Zephyr's generic Bosch M_CAN core; the module-level
	  controller turns on the shared clock gates, initialises the shared
	  Message RAM, and routes the per-channel interrupts through the
	  GRINTx interrupt-compactor.
```

## drivers/ethernet/Kconfig.aurix
```kconfig
# Copyright 2024 Infineon Technologies AG
# SPDX-License-Identifier: Apache-2.0

config ETH_TC4X_LETH
    bool
    depends on DT_HAS_INFINEON_TC4X_LETH_ENABLED
    default y

config ETH_TC4X_GETH
    bool
    depends on DT_HAS_INFINEON_TC4X_GETH_ENABLED
    default y
```

## drivers/ethernet/dwc_ether_qos/Kconfig
```kconfig
# Copyright 2024 Infineon Technologies AG
# SPDX-License-Identifier: Apache-2.0

config ETH_DWC_ETHER_QOS
    bool
    default y
    depends on DT_HAS_SNPS_DWC_ETHER_QOS_ENABLED
    select NET_PKT_LINKING
    select EEPROM if $(dt_compat_any_has_prop,$(DT_COMPAT_SNPS_DWC_ETHER_QOS),mac-eeprom)
    select NET_CHECKSUM_OFFLOAD_SUPPORTED if NET_L2_ETHERNET

if ETH_DWC_ETHER_QOS

config ETH_QOS_NUM_RX_DMA_DESCRIPTORS
    int "Number of RX DMA descriptors"
    default 16

config ETH_QOS_NUM_TX_DMA_DESCRIPTORS
    int "Number of TX DMA descriptors"
    default 16

config ETH_QOS_SHARED_DMA
	bool "Shared DMA between multiple MACs"

config ETH_QOS_TARGET_TIME_CALLBACK
    bool
    default y
endif
```

## drivers/ethernet/dwc_ether_xgmac/Kconfig
```kconfig
config ETH_DWC_ETHER_XGMAC
    bool
    default y
    depends on DT_HAS_SNPS_DWC_ETHER_XGMAC_ENABLED
    select NET_PKT_LIST
    select CACHE_MANAGEMENT if CPU_HAS_DCACHE
    select NET_CHECKSUM_OFFLOAD_SUPPORTED if NET_L2_ETHERNET
    select EEPROM if $(dt_compat_any_has_prop,$(DT_COMPAT_SNPS_DWC_ETHER_QOS),mac-eeprom)

if ETH_DWC_ETHER_XGMAC

config ETH_XGMAC_NUM_RX_DMA_DESCRIPTORS
    int "Number of RX DMA descriptors"
    default 16

config ETH_XGMAC_NUM_TX_DMA_DESCRIPTORS
    int "Number of TX DMA descriptors"
    default 16

config ETH_XGMAC_SHARED_DMA
    bool "Shared DMA between multiple MACs"
    default n

config ETH_XGMAC_TARGET_TIME_CALLBACK
    bool "Target time callback for event triggers"
    default n

config ETH_XGMAC_DMA_PER_CH_IRQ
    bool "DMA per channel interrupt"
    default n
endif
```

## drivers/ethernet/mdio/Kconfig.dwc_ether_qos
```kconfig
# Copyright (c) 2026 Infineon Technologies AG
# SPDX-License-Identifier: Apache-2.0

config MDIO_QOS
	bool "Synopsys DWC Ether QoS MDIO driver"
	depends on DT_HAS_SNPS_DWC_ETHER_QOS_MDIO_ENABLED
	default y
	help
	  Enable Synopsys DWC Ether QoS MDIO driver.
```
