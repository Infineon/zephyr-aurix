/*
 * Copyright (c) 2024 Infineon Technologies AG
 *
 * SPDX-License-Identifier: Apache-2.0
 */

/dts-v1/;

#include <infineon/tc3x/tc397xa.dtsi>
#include "kit_a2g_tc3x7_trb.dtsi"

/ {
	model = "Infineon TC397 TriBoard";
	compatible = "infineon,kit_a2g_tc397_trb",
	             "infineon,tc397",
	             "infineon,tc3x";

	chosen {
		zephyr,flash = &flash2;
		zephyr,sram = &dsram2;
		zephyr,itcm = &psram2;
		infineon,system-timer = &stm2;
	};
};

&stm2 {
	status = "okay";
	freeze;
};
