/*
 * Copyright (c) 2024 Infineon Technologies AG
 *
 * SPDX-License-Identifier: Apache-2.0
 */

/dts-v1/;

#include <infineon/tc3x/tc366dp.dtsi>
#include "kit_a2g_tc3x6_trb.dtsi"

/ {
	model = "Infineon TC397 TriBoard";
	compatible = "infineon,kit_a2g_tc397_trb",
	             "infineon,tc397",
	             "infineon,tc3x";

	chosen {
		zephyr,flash = &flash0;
		zephyr,sram = &dsram0;
		zephyr,itcm = &psram0;
		zephyr,console = &asclin0;
		infineon,system-timer = &stm0;
	};
};

&stm0 {
	status = "okay";
	freeze;
};

&asclin0 {
	status = "okay";
};
