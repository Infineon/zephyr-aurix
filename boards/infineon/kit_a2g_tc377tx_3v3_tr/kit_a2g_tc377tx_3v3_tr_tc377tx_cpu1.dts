/*
 * Copyright (c) 2024 Infineon Technologies AG
 *
 * SPDX-License-Identifier: Apache-2.0
 */

/dts-v1/;

#include <infineon/tc3x/tc377tx.dtsi>
#include "kit_a2g_tc377tx_3v3_tr.dtsi"

/ {
	model = "Infineon TC377TX TriBoard";
	compatible = "infineon,kit_a2g_tc377tx_3v3_tr",
	             "infineon,tc377tx",
	             "infineon,tc3x";

	chosen {
		zephyr,flash = &flash1;
		zephyr,sram = &dsram1;
		zephyr,itcm = &psram1;
		infineon,system-timer = &stm1;
	};
};

&stm1 {
	status = "okay";
	freeze;
};
