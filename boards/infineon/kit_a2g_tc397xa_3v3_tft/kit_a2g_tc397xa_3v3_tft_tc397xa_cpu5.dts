/*
 * Copyright (c) 2024 Infineon Technologies AG
 *
 * SPDX-License-Identifier: Apache-2.0
 */

/dts-v1/;

#include <infineon/tc3x/tc397xa.dtsi>
#include "kit_a2g_tc397xa_3v3_tft.dtsi"

/ {
	model = "Infineon TC397 ADAS Application Kit";
	compatible = "infineon,kit_a2g_tc397xa_3v3_tft",
	             "infineon,tc397",
	             "infineon,tc3xx";

	chosen {
		zephyr,flash = &flash5;
		zephyr,sram = &dsram5;
		zephyr,itcm = &psram5;
		infineon,system-timer = &stm5;
	};
};

&stm5 {
	status = "okay";
	freeze;
};

