/*
 * Copyright (c) 2024 Infineon Technologies AG
 *
 * SPDX-License-Identifier: Apache-2.0
 */

/dts-v1/;

#include <infineon/tc3x/tc397xp.dtsi>
#include "kit_a2g_tc397xa_3v3_tft.dtsi"

/ {
	model = "Infineon TC397 ADAS Application Kit";
	compatible = "infineon,kit_a2g_tc397xa_3v3_tft",
	             "infineon,tc397",
	             "infineon,tc3xx";

	chosen {
		zephyr,flash = &flash4;
		zephyr,sram = &dsram4;
		zephyr,itcm = &psram4;
		infineon,system-timer = &stm4;
	};
};

&stm4 {
	status = "okay";
	freeze;
};

