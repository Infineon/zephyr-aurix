/*
 * Copyright (c) 2024 Infineon Technologies AG
 *
 * SPDX-License-Identifier: Apache-2.0
 */

/dts-v1/;

#include <infineon/tc3x/tc375tp.dtsi>
#include "kit_a2g_tc375_lite.dtsi"

/ {
	model = "Infineon TC375 LiteKit";
	compatible = "infineon,kit_a2g_tc375_lite", "infineon,tc375tp",
						"infineon,tc3x";

	chosen {
		zephyr,flash = &flash1;
		zephyr,sram = &dsram1;
		zephyr,itcm = &psram1;
		infineon,system-timer = &stm1;
	};
};

&stm1 {
	status = "okay";
	freeze;
};
