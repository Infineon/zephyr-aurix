/*
 * Copyright (c) 2025 Infineon Technologies AG
 *
 * SPDX-License-Identifier: Apache-2.0
 */

/dts-v1/;

#include "kit_a3g_tc4d7_lite_tc4d7xp.dtsi"

/ {
	chosen {
		zephyr,flash = &flash4;
		zephyr,sram = &dsram4;
		zephyr,dtcm = &dsram4;
		zephyr,itcm = &psram4;
	};
};
