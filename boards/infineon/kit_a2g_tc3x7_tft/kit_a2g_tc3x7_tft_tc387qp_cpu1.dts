/*
 * Copyright (c) 2024 Infineon Technologies AG
 *
 * SPDX-License-Identifier: Apache-2.0
 */

/dts-v1/;

#include <infineon/tc3x/tc387qp.dtsi>
#include "kit_a2g_tc3x7_tft.dtsi"

/ {
	model = "Infineon TC387QP TFT Application Kit";
	compatible = "infineon,kit_a2g_tc3x7_tft",
	             "infineon,tc387qp",
	             "infineon,tc3x";

	chosen {
		zephyr,flash = &flash1;
		zephyr,sram = &dsram1;
		zephyr,itcm = &psram1;
		infineon,system-timer = &stm1;
	};
};

&stm1 {
	status = "okay";
	freeze;
};
