/*
 * Copyright (c) 2024 Infineon Technologies AG
 *
 * SPDX-License-Identifier: Apache-2.0
 */

/dts-v1/;

#include <infineon/tc3x/tc387qp.dtsi>
#include "kit_a2g_tc3x7_tft.dtsi"

/ {
	model = "Infineon TC387QP TFT Application Kit";
	compatible = "infineon,kit_a2g_tc3x7_tft",
	             "infineon,tc387qp",
	             "infineon,tc3x";

	chosen {
		zephyr,flash = &flash2;
		zephyr,sram = &dsram2;
		zephyr,itcm = &psram2;
		infineon,system-timer = &stm2;
	};
};

&stm2 {
	status = "okay";
	freeze;
};
