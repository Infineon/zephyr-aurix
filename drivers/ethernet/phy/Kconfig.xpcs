## drivers/ethernet/phy/Kconfig.xpcs
```kconfig
config PHY_XPCS
    bool "Synopsis XPCS Interface"
    default y
    depends on DT_HAS_SNPS_XPCS_ENABLED

if PHY_XPCS

endif
```

## drivers/i2c/Kconfig.aurix
```kconfig
# Copyright (c) 2024 Infineon Technologies AG
# SPDX-License-Identifier: Apache-2.0

menuconfig I2C_AURIX
	bool "I2C support for Aurix SoCs"
	default y
	depends on DT_HAS_INFINEON_AURIX_I2C_ENABLED
	select EVENTS
	select PINCTRL
	help
	  Enable the Aurix I2C driver. The driver uses the AURIX HAL SFR
	  register layout (Ifx_I2C) and implements polling-style transfer
	  with k_event signalling from the protocol/data-transfer ISRs.
```

## drivers/lin/Kconfig.asclin
```kconfig
# Infineon AURIX ASCLIN LIN driver configuration options

# Copyright (c) 2026 Linumiz
# SPDX-License-Identifier: Apache-2.0

config LIN_ASCLIN
	bool "Infineon AURIX ASCLIN LIN driver"
	default y
	depends on DT_HAS_INFINEON_ASCLIN_LIN_ENABLED
	depends on SOC_SERIES_TC4X || SOC_SERIES_TC3X
	help
	  Enable LIN driver for the ASCLIN peripheral on Infineon AURIX
	  TC3xx and TC4xx families. TC2xx ASCLIN is not supported (older
	  register variant).
```

## drivers/mbox/Kconfig.aurix
```kconfig
# Copyright 2024 Infineon Technologies AG
# SPDX-License-Identifier: Apache-2.0

config MBOX_AURIX
	bool "AURIX Mbox driver"
	default y
	depends on DT_HAS_INFINEON_AURIX_GPSR_ENABLED
	depends on AURIX_IR
	select NOCACHE_MEMORY if ARCH_HAS_NOCACHE_MEMORY_SUPPORT
	help
	  Enable the AURIX MBOX driver. The driver uses the AURIX
	  interrupt router (SR) GPSR group as a software-triggered
	  doorbell with an optional 16-bit payload (TC4x).
```

## drivers/ptp_clock/Kconfig.dwc_ether_qos
```kconfig
# Copyright (c) 2026 Infineon Technologies AG
# SPDX-License-Identifier: Apache-2.0

config PTP_CLOCK_DWC_ETHER_QOS
	bool "Synopsis DWC Ether QoS PTP Clock"
	default y
	depends on DT_HAS_SNPS_DWC_ETHER_QOS_PTP_CLOCK_ENABLED && NET_L2_PTP
	depends on ETH_DWC_ETHER_QOS || ETH_DWC_ETHER_XGMAC
	help
	  Enable Synopsis Designwer Ethernet QoS PTP Clock
```

## drivers/spi/Kconfig.aurix_qspi
```kconfig
# Copyright (c) 2026 Infineon Technologies AG,
# or an affiliate of Infineon Technologies AG.

# SPDX-License-Identifier: Apache-2.0


config INFINEON_AURIX_QSPI
bool "Infineon Aurix QSPI driver"
default y
depends on DT_HAS_INFINEON_AURIX_QSPI_ENABLED
select GPIO
help
	  This option enables the driver for Queued Synchronous Peripheral Interface.

config SPI_AURIX_QSPI_MAX_SLAVE
int "Maximum number of QSPI slaves"
default 16
depends on INFINEON_AURIX_QSPI
help
	  This option sets the maximum number of QSPI slaves supported by the driver.
```

## drivers/watchdog/Kconfig.aurix
```kconfig
# Infineon TC3xx WDT configuration

# Copyright (C) 2024 Infineon Technologies AG
# SPDX-License-Identifier: Apache-2.0

config WDT_AURIX
	bool "Infineon Aurix MUCs Watchdog Driver"
	default y
	select HAS_WDT_DISABLE_AT_BOOT
	depends on DT_HAS_INFINEON_AURIX_WATCHDOG_ENABLED
	help
	  Enable CPU WDT driver for Infineon Aurix MCUs.
```

## dts/bindings/can/infineon,mcmcan-node.yaml
```yaml
# Copyright (c) 2024 Infineon Technologies AG
# SPDX-License-Identifier: Apache-2.0

description: |
  Single AURIX CAN-FD channel inside an MCMCAN module.

  Each channel exposes a Bosch M_CAN register block plus a slice of the
  shared module Message RAM.  The driver wires this node up to the
  generic Zephyr can_mcan core.

compatible: "infineon,mcmcan-node"

include: ["bosch,m_can-base.yaml", "pinctrl-device.yaml"]

properties:
  reg:
    required: true
    description: |
      Two register regions:
        m_can:       channel-specific M_CAN register block.
        message_ram: base of the (shared) module Message RAM. The
                     "bosch,mram-cfg" property below selects the per-channel
                     offsets within this region.
  reg-names:
    required: true
  interrupts:
    required: true
  interrupt-names:
    required: true
    description: Two named lines, "line0" and "line1".
```

## dts/bindings/can/infineon,mcmcan.yaml
```yaml
# Copyright (c) 2024 Infineon Technologies AG
# SPDX-License-Identifier: Apache-2.0

description: |
  Infineon AURIX MCMCAN module (TC3x/TC4x).

  This is the wrapper-level node for an AURIX CAN module.  It owns the
  shared module control register (MCR), the per-module Message RAM, the
  module-level clock gates, and the per-channel interrupt-compactor
  (GRINTx) registers.  Individual CAN-FD channels are described as child
  nodes with the "infineon,mcmcan-node" compatible.

compatible: "infineon,mcmcan"

include: ["base.yaml"]

properties:
  reg:
    required: true
  clocks:
    required: true
    description: |
      Two clock specifiers in this exact order:
        0: synchronous bus clock (fmcan)
        1: asynchronous async clock (fmcanh)
      Both clocks are enabled by the wrapper driver before any channel
      is brought up.
```

## dts/bindings/ethernet/infineon,tc3x-geth.yaml
```yaml
# Copyright 2024 Infineon Technologies AG
# SPDX-License-Identifier: Apache-2.0

---
description: TC3x GETH wrapper module
compatible: infineon,tc3x-geth

include: [base.yaml]

properties:
  skip-init:
    type: boolean
```

## dts/bindings/ethernet/infineon,tc4x-geth.yaml
```yaml
# Copyright (c) 2024, Infineon Technologies AG
# SPDX-License-Identifier: Apache-2.0

description: Infineon TC4X GETH module

compatible: "infineon,tc4x-geth"

include: [base.yaml, pinctrl-device.yaml]

properties:
  clocks:
    required: true
  clock-names:
    required: true
  hsphy:
    type: phandle
    description: HSPHY module providing the Ethernet PHY interface for this GETH instance.
```

## dts/bindings/ethernet/infineon,tc4x-leth.yaml
```yaml
# Copyright 2024 Infineon Technologies AG
# SPDX-License-Identifier: Apache-2.0

description: LETH wrapper module
compatible: infineon,tc4x-leth

include: [base.yaml]

properties:
  skip-init:
    type: boolean
```

## dts/bindings/ethernet/mdio/snps,dwc-ether-xgmac-mdio.yaml
```yaml
# Copyright (c) 2024 Infineon Technologies AG
# SPDX-License-Identifier: Apache-2.0

description: Synopsys DWC Ethernet XGMAC MDIO node

compatible: "snps,dwc-ether-xgmac-mdio"

include:
  - name: mdio-controller.yaml
  - name: pinctrl-device.yaml
```

## dts/bindings/ethernet/phy/infineon,tc4x-hsphy.yaml
```yaml
# Copyright (c) 2024, Infineon Technologies AG
# SPDX-License-Identifier: Apache-2.0

description: Infineon TC4X HSPHY module

compatible: "infineon,tc4x-hsphy"
```

## dts/bindings/ethernet/phy/oa,t1s-pmd-xcvr.yaml
```yaml
# Copyright (c) 2026 Infineon Technologies AG
# SPDX-License-Identifier: Apache-2.0
description: OpenAlliance TC14 PMD XCVR PHY
compatible: "oa,t1s-pmd-xcvr"
include: phy.yaml

properties:
  reg:
    required: true
    description: PHY address
    const:
      - 1
```

## dts/bindings/ethernet/phy/realtek,rtl8201f.yaml
```yaml
# Copyright 2026 Infineon Technologies AG
# SPDX-License-Identifier: Apache-2.0

description: Realtek RTL8201F Ethernet PHY device

compatible: "realtek,rtl8201f"

include: ethernet-phy-common.yaml

properties:
  reset-gpios:
    type: phandle-array
    description: GPIO connected to PHY reset signal pin. Reset is active low.
  int-gpios:
    type: phandle-array
    description: GPIO for interrupt signal indicating PHY state change.
  default-speeds:
    default: ["10BASE Half-Duplex", "10BASE Full-Duplex", "100BASE Half-Duplex",
              "100BASE Full-Duplex"]
  eee-enable:
    type: boolean
    description: Enable Energy Efficient Ethernet (EEE) support.
```

## dts/bindings/ethernet/phy/realtek,rtl822x.yaml
```yaml
# Copyright 2024 Infineon Technologies AG
# SPDX-License-Identifier: Apache-2.0

description: Realtek RTL822x Ethernet PHY device

compatible: "realtek,rtl822x"

include: ethernet-phy-common.yaml

properties:
  reg:
    type: array
    required: true
  no-reset:
    type: boolean
    description: Do not reset the PHY during initialization
  fixed-link:
    type: string
    description: This link is fixed and does not require PHY configuration
    enum:
      - "10BASE-T Half-Duplex"
      - "10BASE-T Full-Duplex"
      - "100BASE-T Half-Duplex"
      - "100BASE-T Full-Duplex"
      - "1000BASE-T Half-Duplex"
      - "1000BASE-T Full-Duplex"
      - "2500BASE-T Full-Duplex"
      - "5000BASE-T Full-Duplex"
  reset-gpios:
    type: phandle-array
    description: GPIO connected to PHY reset signal pin. Reset is active low.
  int-gpios:
    type: phandle-array
    description: GPIO for interrupt signal indicating PHY state change.
  realtek,serdes-interface:
    type: string
    default: "HiSGMII"
    enum:
      - "2500Base-X+SGMII"
      - "HiSGMII+SGMII"
      - "2500Base-X"
      - "HiSGMII"
    description: Select SERDES interface type between PHY and SoC
  realtek,serdes-auto-negotiation:
    type: boolean
    description: Enable Clause 37 auto-negotiation between PHY and SoC
  eee-en:
    type: boolean
    description: |
      Enable IEEE 802.3az Energy Efficient Ethernet which provides a mechanism
      to greatly save the power consumption between data packets burst.
  pma-local-loopback:
    type: boolean
    description: Enable loopback between Phy PMA TX and PHY PMA RX.
```

## dts/bindings/ethernet/phy/snps,t1s-phy.yaml
```yaml
# Copyright (c) 2026 Infineon Technologies AG
# SPDX-License-Identifier: Apache-2.0
description: Synopsys 10BASE-T1S PHY
compatible: "snps,t1s-phy"
include: phy.yaml

properties:
  reg:
    required: true
    description: PHY address

  plca-enable:
    type: boolean
    description: Enable or disable PLCA support
  disable-physical-collision:
    type: boolean
    description: Set PCS control PCD bit to disable physical collision detection
  plca-buf-depth:
    type: int
    description: PLCA receive buffer depth (PVBD field)
  plca-node-id:
    type: int
    description: Specify the PLCA node ID number
  plca-node-count:
    type: int
    description: Specify the PLCA node count
  plca-burst-count:
    type: int
    description: Specify the PLCA burst count
  plca-burst-timer:
    type: int
    description: Specify the PLCA burst timer value
  plca-to-timer:
    type: int
    description: Specify the PLCA to timer value
```

## dts/bindings/ethernet/phy/snps,xpcs.yaml
```yaml
compatible: "snps,xpcs"

description: Synopsys DesignWareCore XPCS

include: ethernet-phy-common.yaml

properties:
  reg:
    required: true
  phy-handle:
    type: phandle
  fixed-link:
    type: string
    description: This link is fixed and does not require PHY configuration
    enum:
      - "10BASE-T Half-Duplex"
      - "10BASE-T Full-Duplex"
      - "100BASE-T Half-Duplex"
      - "100BASE-T Full-Duplex"
      - "1000BASE-T Half-Duplex"
      - "1000BASE-T Full-Duplex"
      - "2500BASE-T Full-Duplex"
      - "5000BASE-T Full-Duplex"
```

## dts/bindings/ethernet/snps,dwc-ether-qos-ptp-clock.yaml
```yaml
# Copyright 2024 Infineon Technologies AG
# SPDX-License-Identifier: Apache-2.0

description: Synopsys IP Ethernet QoS PTP (Precision Time Protocol) Clock

compatible: "snps,dwc-ether-qos-ptp-clock"

include: ["base.yaml"]

properties:
  clocks:
    type: phandle-array
    required: true
  resolution:
    type: int
```

## dts/bindings/ethernet/snps,dwc-ether-qos.yaml
```yaml
# Copyright (c) 2025, Infineon Technologies AG
# SPDX-License-Identifier: Apache-2.0

description: Synopsys DesignWare Ethernet

compatible: "snps,dwc-ether-qos"

include:
  - ethernet-controller.yaml
  - pinctrl-device.yaml
properties:
  reg:
    required: true
  snps,do-reset:
    type: boolean
  snps,skip-init:
    type: boolean
  snps,dma-only:
    type: boolean
  snps,dma:
    type: phandle
  mac-eeprom:
    type: phandle
    description: EEPROM holding a factory EUI-48 to use as the MAC address.
  mac-eeprom-offset:
    type: int
    default: 250
    description: Byte offset of the EUI-48 within the mac-eeprom (default 0xFA).
  snps,ptp-clock:
    type: phandle
  snps,tx-queue-sources:
    type: phandle-array
    ignore-dependencies: true
  snps,rx-channel-targets:
    type: phandle-array
    ignore-dependencies: true
  snps,rx-channels-to-use:
    type: int
    default: 1
  snps,rx-descriptors:
    type: array
  snps,tx-descriptors:
    type: array
  snps,channel-nr:
    type: array
  snps,address-aligned-burst:
    type: boolean
  snps,fixed-burst-length:
    type: boolean
  snps,burst-length:
    type: int
    enum: [1, 2, 4, 8, 16, 32, 64, 128, 256]
    default: 1
  snps,loopback:
    type: boolean
  snps,da-duplication:
    type: boolean
  '#snps,tx-queue-source-cells':
    type: int
    const: 1
  '#snps,rx-channel-target-cells':
    type: int
    const: 1

snps,tx-queue-source-cells:
  - channel
snps,rx-channel-target-cells:
  - channel
```

## dts/bindings/ethernet/snps,dwc-ether-xgmac-dma.yaml
```yaml
# Copyright (c) 2024, Infineon Technologies AG
# SPDX-License-Identifier: Apache-2.0

description: Synopsys IP Ethernet XGMAC DMA

compatible: "snps,dwc-ether-xgmac-dma"

include: [base.yaml]

properties:
  reg:
    required: true
  snps,channel:
    type: int
    default: 8
  '#snps,tx-queue-source-cells':
    type: int
    const: 1
  '#snps,rx-channel-target-cells':
    type: int
    const: 1

snps,tx-queue-source-cells:
  - channel
snps,rx-channel-target-cells:
  - channel
```

## dts/bindings/ethernet/snps,dwc-ether-xgmac-rx-queues.yaml
```yaml
# Copyright (c) 2024, Infineon Technologies AG
# SPDX-License-Identifier: Apache-2.0

description: RX Queues Configuration for Synopsis DWC Ether XGMAC

compatible: "snps,dwc-ether-xgmac-rx-queues"

properties:
  snps,rx-sched-sp:
    type: boolean
    description: Strict priority
  snps,rx-sched-wsp:
    type: boolean
    description: Weighted Strict priority

child-binding:
  description: RX Queue configuration

  properties:
    reg:
      type: int
    snps,size:
      type: int
      description: Dedicated Fifo size
    snps,threshold:
      type: int
      enum:
        - 32
        - 64
        - 96
        - 128
        - 192
        - 256
        - 384
        - 512
    snps,cut-through:
      type: boolean
    snps,store-and-forward:
      type: boolean
    snps,dcb-algorithm:
      type: boolean
      description: Queue to be enabled as DCB
    snps,avb-algorithm:
      type: boolean
      description: Queue to be enabled as AVB
    snps,map-to-dma-channel:
      type: int
      description: DMA channel id to map
    snps,route-avcp:
      type: boolean
      description: AV Untagged Control packets
    snps,route-ptp:
      type: boolean
      description: PTP Packets
    snps,route-dcbcp:
      type: boolean
      description: DCB Control Packets
    snps,route-up:
      type: boolean
      description: Untagged Packets
    snps,route-multi-broad:
      type: boolean
      description: Multicast & Broadcast Packets
    snps,priority:
      type: int
      description: Bitmask of the tagged frames priorities assigned to the queue
    snps,size:
      type: int
      description: Size of queue memeory
```

## dts/bindings/gpio/infineon,tc3x-gpio.yaml
```yaml
# Copyright (c) 2024 Infineon Technologies AG
# SPDX-License-Identifier: Apache-2.0

description: Infineon TC3x Port Module

compatible: "infineon,tc3x-gpio"

include: [gpio-controller.yaml, base.yaml]

properties:
  reg:
    required: true

  irq-sources:
    type: array
    description: |
      Optional list of GPIO IRQ sources tied to specific pins on
      this port. Each entry is a packed encoding produced by the
      AURIX_GPIO_IRQ_TIM() macro from the SoC's gpio_irq.h header
      (pin, GTM TIM unit, channel, mux). Entries are paired in
      order with the node's interrupts property: irq-sources[i]
      uses interrupts[i].

  "#gpio-cells":
    const: 2

gpio-cells:
  - pin
  - flags
```
